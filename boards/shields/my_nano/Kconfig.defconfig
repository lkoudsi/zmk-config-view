## boards/shields/my_nano/Kconfig.defconfig
```kconfig
# Copyright (c) 2023 The ZMK Contributors
# SPDX-License-Identifier: MIT

if SHIELD_MY_NANO_VIEW

config LS0XX_VCOM_THREAD_PRIO
    int
    default 11

config LV_Z_VDB_SIZE
    int
    default 100

config LV_DPI_DEF
    int
    default 161

config LV_Z_BITS_PER_PIXEL
    int
    default 1

choice LV_COLOR_DEPTH
    default LV_COLOR_DEPTH_1
endchoice

choice ZMK_DISPLAY_WORK_QUEUE
    default ZMK_DISPLAY_WORK_QUEUE_DEDICATED

config ZMK_DISPLAY_WORK_QUEUE_SYSTEM
    bool "Use default system work queue for UI updates"

config ZMK_DISPLAY_WORK_QUEUE_DEDICATED
    bool "Use dedicated work queue for UI updates"

endchoice

choice ZMK_DISPLAY_STATUS_SCREEN
    default ZMK_DISPLAY_STATUS_SCREEN_CUSTOM

config ZMK_DISPLAY_STATUS_SCREEN_BUILT_IN
    bool "Built in status screen"
    select LV_FONT_MONTSERRAT_26

config ZMK_DISPLAY_STATUS_SCREEN_CUSTOM
    bool "Custom status screen"
    imply NICE_VIEW_WIDGET_STATUS

endchoice

config LV_Z_MEM_POOL_SIZE
    int
    default 8192 if ZMK_DISPLAY_STATUS_SCREEN_CUSTOM
    default 5120 if ZMK_DISPLAY_STATUS_SCREEN_BUILT_IN

config NICE_VIEW_WIDGET_STATUS
    bool "Custom nice!view status widget"
    select LV_FONT_MONTSERRAT_16
    select LV_USE_IMG
    select LV_USE_CANVAS

config NICE_VIEW_WIDGET_INVERTED
    bool "Invert custom status widget colors"

if !ZMK_SPLIT || ZMK_SPLIT_ROLE_CENTRAL

config NICE_VIEW_WIDGET_STATUS
    select LV_FONT_MONTSERRAT_18
    select LV_FONT_MONTSERRAT_14
    select LV_FONT_UNSCII_8
    select ZMK_WPM

endif # !ZMK_SPLIT || ZMK_SPLIT_ROLE_CENTRAL

endif # SHIELD_MY_NANO_VIEW
 
```

## boards/shields/my_nano/Kconfig.shield
```kconfig
# Copyright (c) 2022 The ZMK Contributors
# SPDX-License-Identifier: MIT

config SHIELD_MY_NANO_VIEW
    def_bool $(shields_list_contains,my_nano)
```
